## sound/soc/hisilicon/Kconfig
```kconfig
menu "SoC Audio support for HI3630"

config SND_SOC_PCM_HI3650
	tristate "SoC Audio support for HI3650"
	help
	  Say y to enable this option for HI3630 I2S audio support.

config SND_HI3650_HI6402
	tristate "Hi3650-Hi6402 sound support"
	select HI6402_CODEC
	select SND_SOC_HI6402
	help
	  Say y to enable sound support for Hi3630-Hi6402

endmenu
```
